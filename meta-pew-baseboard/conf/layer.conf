## meta-pew-baseboard/conf/layer.conf
```bitbake
# We have a conf and classes directory, add to BBPATH
BBPATH .= ":${LAYERDIR}"

# We have recipes-* directories, add to BBFILES
BBFILES += "${LAYERDIR}/recipes-*/*/*.bb \
            ${LAYERDIR}/recipes-*/*/*.bbappend"

BBFILE_COLLECTIONS += "meta-pew-baseboard"
BBFILE_PATTERN_meta-pew-baseboard = "^${LAYERDIR}/"
BBFILE_PRIORITY_meta-pew-baseboard = "9"

LAYERDEPENDS_meta-pew-baseboard = "core"
LAYERSERIES_COMPAT_meta-pew-baseboard = "kirkstone"

# meta-qt6/conf/layer.confにてSPDXLICENSEMAPに不適切な値が設定されている。
# これにより、INCOMPATIBLE_LICENSEに"GPL-3.0* LGPL-3.0*"を指定しても、
# "GPL-3.0-only"と"LGPL-3.0-only"のパッケージが排除されなくなっている。
# このため、以下でmeta-qt6/conf/layer.confの設定を取り消す。
SPDXLICENSEMAP[GPL-3.0-only] = "GPL-3.0-only"
SPDXLICENSEMAP[LGPL-3.0-only] = "LGPL-3.0-only"
SPDXLICENSEMAP[GPL-2.0-or-later] = "GPL-2.0-or-later"
```

## meta-pew-baseboard/conf/machine/imx8mnpewbizgw.conf
```bitbake
#@TYPE: Machine
#@NAME: Panasonic Electric Works business i.MX8MN gateway board
#@SOC: i.MX8MN
#@DESCRIPTION: Machine configuration for Panasonic Electric Works i.MX8MN business gateway board
#@MAINTAINER:

MACHINEOVERRIDES =. "mx8mn:"

require conf/machine/include/imx-base.inc
require conf/machine/include/arm/armv8a/tune-cortexa53.inc

IMX_DEFAULT_BSP = "nxp"

MACHINE_FEATURES:append = " optee"
MACHINE_FEATURES:remove = " usbgadget vfat qca6174 bcm43455 bcm4356 jailhouse alsa touchscreen nxp8987 nxp8987"

MACHINEOVERRIDES =. "imx8mn-pew-bizgw:"

KERNEL_DEVICETREE_BASENAME = "imx8mn-pew-bizgw"
KERNEL_DEVICETREE = "freescale/imx8mn-pew-bizgw.dtb"

UBOOT_CONFIG_BASENAME = "imx8mn_pew_bizgw"

DDR_FIRMWARE_NAME = " \
    lpddr4_pmu_train_1d_imem.bin \
    lpddr4_pmu_train_1d_dmem.bin \
    lpddr4_pmu_train_2d_imem.bin \
    lpddr4_pmu_train_2d_dmem.bin \
"

IMXBOOT_TARGETS_BASENAME = "flash_evk"
IMXBOOT_TARGETS = "${IMXBOOT_TARGETS_BASENAME}"

UBOOT_DTB_NAME = "imx8mn-pew-bizgw.dtb"

IMX_DEFAULT_BOOTLOADER = "u-boot-imx"

UBOOT_SUFFIX = "bin"

UBOOT_CONFIG ??= "sd"
UBOOT_CONFIG[sd] = "imx8mn_pew_bizgw_config,sdcard"

SPL_BINARY = "spl/u-boot-spl.bin"

ATF_PLATFORM = "imx8mn"

IMX_BOOT_SOC_TARGET = "iMX8MN"

SERIAL_CONSOLES = "115200;ttymxc1"

BOOT_SPACE = "65536"
LOADADDR = ""
UBOOT_MAKE_TARGET = "all"

# Image boot offset as defined in section 6.1.6.1 "Primary image offset and IVT offset" of
# i.MX 8M Nano Applications Processor Reference Manual, Rev. 0, 12/2019
# Doc ID: IMX8MNRM
IMX_BOOT_SEEK = "32"

OPTEE_BIN_EXT = "8mn"
TEE_LOAD_ADDR = "0x56000000"

do_image_wic[depends] += "addscr:do_deploy"
```

## meta-pew-baseboard/conf/machine/imx8mnpewgw.conf
```bitbake
#@TYPE: Machine
#@NAME: Panasonic Electric Works i.MX8MN gateway board
#@SOC: i.MX8MN
#@DESCRIPTION: Machine configuration for Panasonic Electric Works i.MX8MN gateway board
#@MAINTAINER:

MACHINEOVERRIDES =. "mx8mn:"

require conf/machine/include/imx-base.inc
require conf/machine/include/arm/armv8a/tune-cortexa53.inc

IMX_DEFAULT_BSP = "nxp"

MACHINE_FEATURES:append = " optee wifi bluetooth"
MACHINE_FEATURES:remove = " usbgadget vfat qca6174 bcm43455 bcm4356 jailhouse touchscreen"

MACHINEOVERRIDES =. "imx8mn-pew-gw:"

KERNEL_DEVICETREE_BASENAME = "imx8mn-pew-gw"
KERNEL_DEVICETREE = "freescale/imx8mn-pew-gw.dtb"

UBOOT_CONFIG_BASENAME = "imx8mn_pew_gw"

DDR_FIRMWARE_NAME = " \
    lpddr4_pmu_train_1d_imem.bin \
    lpddr4_pmu_train_1d_dmem.bin \
    lpddr4_pmu_train_2d_imem.bin \
    lpddr4_pmu_train_2d_dmem.bin \
"

IMXBOOT_TARGETS_BASENAME = "flash_evk"
IMXBOOT_TARGETS = "${IMXBOOT_TARGETS_BASENAME}"

UBOOT_DTB_NAME = "imx8mn-pew-gw.dtb"

IMX_DEFAULT_BOOTLOADER = "u-boot-imx"

UBOOT_SUFFIX = "bin"

UBOOT_CONFIG ??= "sd"
UBOOT_CONFIG[sd] = "imx8mn_pew_gw_config,sdcard"

SPL_BINARY = "spl/u-boot-spl.bin"

ATF_PLATFORM = "imx8mn"

IMX_BOOT_SOC_TARGET = "iMX8MN"

SERIAL_CONSOLES = "115200;ttymxc1"

BOOT_SPACE = "65536"
LOADADDR = ""
UBOOT_MAKE_TARGET = "all"

# Image boot offset as defined in section 6.1.6.1 "Primary image offset and IVT offset" of
# i.MX 8M Nano Applications Processor Reference Manual, Rev. 0, 12/2019
# Doc ID: IMX8MNRM
IMX_BOOT_SEEK = "32"

OPTEE_BIN_EXT = "8mn"
TEE_LOAD_ADDR = "0x56000000"

do_image_wic[depends] += "addscr:do_deploy"
```
